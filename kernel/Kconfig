## kernel/Kconfig
```kconfig
config DRM_PANEL_ILI9486
	tristate "Ilitek ILI9486 panel"
	depends on OF && SPI && DRM_MIPI_DBI
	help
	  Say Y here if you want to enable support for Ilitek ILI9486
	  panels connected to a SPI bus.
```
